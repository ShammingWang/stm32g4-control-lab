# file: blink_led.ioc
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Mcu.Family=STM32G4
Mcu.Name=STM32G431R(6-8-B)Tx
Mcu.Package=LQFP64
NUCLEO-G431RB.BUTTON=1
NUCLEO-G431RB.LD1=false
NUCLEO-G431RB.VCP=true
NVIC.EXTI15_10_IRQn=true\:0\:0\:false\:false\:true\:false\:true\:true
NVIC.PriorityGroup=NVIC_PRIORITYGROUP_4
NVIC.TIM6_DAC_IRQn=true\:1\:0\:false\:false\:true\:true\:true\:true
PA13.GPIO_Label=T_SWDIO
PA13.Mode=Serial_Wire
PA13.Signal=SYS_JTMS-SWDIO
PA14.GPIO_Label=T_SWCLK
PA14.Mode=Serial_Wire
PA14.Signal=SYS_JTCK-SWCLK
PA2.Signal=LPUART1_TX
PA3.Signal=LPUART1_RX
PA5.Mode=PWM Generation1 CH1
PA5.Signal=S_TIM2_CH1
PB3.GPIO_Label=T_SWO
PB3.Signal=SYS_JTDO-SWO
PC14-OSC32_IN.GPIO_Label=RCC_OSC32_OUT
PC14-OSC32_IN.Signal=RCC_OSC32_IN
PC15-OSC32_OUT.GPIO_Label=RCC_OSC32_OUT
PC15-OSC32_OUT.Signal=RCC_OSC32_OUT
PF0-OSC_IN.GPIO_Label=RCC_OSC_IN
PF0-OSC_IN.Signal=RCC_OSC_IN
PF1-OSC_OUT.GPIO_Label=RCC_OSC_OUT
PF1-OSC_OUT.Signal=RCC_OSC_OUT
ProjectManager.HeapSize=0x200
ProjectManager.StackSize=0x400
ProjectManager.TargetToolchain=CMake
RCC.ADC12Freq_Value=170000000
RCC.AHBFreq_Value=170000000
RCC.APB1Freq_Value=170000000
RCC.APB1TimFreq_Value=170000000
RCC.APB2Freq_Value=170000000
RCC.APB2TimFreq_Value=170000000
RCC.CortexFreq_Value=170000000
RCC.EXTERNAL_CLOCK_VALUE=12288000
RCC.HCLKFreq_Value=170000000
RCC.HSE_VALUE=24000000
RCC.HSI48_VALUE=48000000
RCC.HSI_VALUE=16000000
RCC.LSE_VALUE=32768
RCC.PLLM=RCC_PLLM_DIV4
RCC.PLLN=85
RCC.RTCClockSelection=RCC_RTCCLKSOURCE_LSE
RCC.SYSCLKFreq_VALUE=170000000
RCC.SYSCLKSource=RCC_SYSCLKSOURCE_PLLCLK
RCC.USBFreq_Value=170000000
RCC.VCOOutputFreq_Value=340000000
TIM2.AutoReloadPreload=TIM_AUTORELOAD_PRELOAD_ENABLE
TIM2.Channel-PWM\ Generation1\ CH1=TIM_CHANNEL_1
TIM2.Period=999
TIM2.Prescaler=169
TIM2.Pulse-PWM\ Generation1\ CH1=0
TIM6.Period=99
TIM6.Prescaler=16999
VP_TIM6_VS_ClockSourceINT.Mode=Enable_Timer
VP_TIM2_VS_ClockSourceINT.Mode=Internal
VP_NUCLEO-G431RB_VS_BSP_COMMON.Mode=COMMON
VP_SYS_VS_DBSignals.Mode=DisableDeadBatterySignals
board=NUCLEO-G431RB

// file: Core/Src/main.c
/* USER CODE BEGIN Header */
/**
  ******************************************************************************
  * @file           : main.c
  * @brief          : Main program body
  ******************************************************************************
  * @attention
  *
  * Copyright (c) 2026 STMicroelectronics.
  * All rights reserved.
  *
  * This software is licensed under terms that can be found in the LICENSE file
  * in the root directory of this software component.
  * If no LICENSE file comes with this software, it is provided AS-IS.
  *
  ******************************************************************************
  */
/* USER CODE END Header */
#include "main.h"

/* USER CODE BEGIN Includes */
#include <stdbool.h>
/* USER CODE END Includes */

/* USER CODE BEGIN PD */
#define UART_COMMAND_QUEUE_SIZE 32U

/* USER CODE END PD */

TIM_HandleTypeDef htim2;
TIM_HandleTypeDef htim6;

COM_InitTypeDef BspCOMInit;

/* USER CODE BEGIN PV */
/* Interrupt reception needs a buffer that outlives the initialization call. */
static uint8_t uartRxByte;
static volatile bool isPaused = false;
/* One producer (UART IRQ), one consumer (main loop); capacity is 31 commands. */
static volatile uint8_t uartCommands[UART_COMMAND_QUEUE_SIZE];
static volatile uint32_t uartCommandHead;
static volatile uint32_t uartCommandTail;

/* USER CODE END PV */

void SystemClock_Config(void);
static void MX_GPIO_Init(void);
static void MX_TIM2_Init(void);
static void MX_TIM6_Init(void);
void HAL_TIM_MspPostInit(TIM_HandleTypeDef *htim);
/* USER CODE BEGIN PFP */
static void UART_ProcessCommand(void);

/* USER CODE END PFP */

int main(void)
{

  /* USER CODE BEGIN 1 */
  // static const uint8_t message[] = "Hello STM32\r\n";
  // uint32_t lastSendTick = 0;

  /* USER CODE END 1 */

  /* MCU Configuration--------------------------------------------------------*/

  /* Reset of all peripherals, Initializes the Flash interface and the Systick. */
  HAL_Init();

  /* Configure the system clock */
  SystemClock_Config();

  /* Initialize all configured peripherals */
  MX_GPIO_Init();
  MX_TIM2_Init();
  MX_TIM6_Init();
  /* USER CODE BEGIN 2 */

  /* PA5 is driven by TIM2_CH1; do not reinitialize it with BSP_LED_Init. */
  if (HAL_TIM_PWM_Start(&htim2, TIM_CHANNEL_1) != HAL_OK)
  {
    Error_Handler();
  }

  /* Initialization generates an update flag; clear it before enabling IRQs. */
  __HAL_TIM_CLEAR_FLAG(&htim6, TIM_FLAG_UPDATE);
  if (HAL_TIM_Base_Start_IT(&htim6) != HAL_OK)
  {
    Error_Handler();
  }

  /* USER CODE END 2 */

  /* Initialize USER push-button, will be used to trigger an interrupt each time it's pressed.*/
  BSP_PB_Init(BUTTON_USER, BUTTON_MODE_EXTI);

  /* Initialize COM1 port (115200, 8 bits (7-bit data + 1 stop bit), no parity */
  BspCOMInit.BaudRate   = 115200;
  BspCOMInit.WordLength = COM_WORDLENGTH_8B;
  BspCOMInit.StopBits   = COM_STOPBITS_1;
  BspCOMInit.Parity     = COM_PARITY_NONE;
  BspCOMInit.HwFlowCtl  = COM_HWCONTROL_NONE;
  if (BSP_COM_Init(COM1, &BspCOMInit) != BSP_ERROR_NONE)
  {
    Error_Handler();
  }

  /* Infinite loop */
  /* USER CODE BEGIN WHILE */
  /* BSP_COM_Init above prepares LPUART1 and its TX/RX pins. */
  HAL_NVIC_SetPriority(LPUART1_IRQn, 15, 0);
  HAL_NVIC_EnableIRQ(LPUART1_IRQn);
  if (HAL_UART_Receive_IT(&hcom_uart[COM1], &uartRxByte, 1U) != HAL_OK)
  {
    Error_Handler();
  }

  while (1)
  {
    /* PWM runs in TIM2; TIM6 interrupts adjust the brightness. */
    __WFI();
    /* USER CODE END WHILE */

    /* USER CODE BEGIN 3 */
    UART_ProcessCommand();

    /* Send from the main loop; timer interrupts keep the LED breathing. */
    // uint32_t now = HAL_GetTick();
    // if ((uint32_t)(now - lastSendTick) >= 1000U)
    // {
    //   lastSendTick = now;
    //   /* Exclude the string's terminating NUL byte from transmission. */
    //   if (HAL_UART_Transmit(&hcom_uart[COM1], message,
    //                         sizeof(message) - 1U, 100U) != HAL_OK)
    //   {
    //     Error_Handler();
    //   }
    // }
  }
  /* USER CODE END 3 */
}

void SystemClock_Config(void)
{
  RCC_OscInitTypeDef RCC_OscInitStruct = {0};
  RCC_ClkInitTypeDef RCC_ClkInitStruct = {0};

  /** Configure the main internal regulator output voltage
  */
  HAL_PWREx_ControlVoltageScaling(PWR_REGULATOR_VOLTAGE_SCALE1_BOOST);

  /** Initializes the RCC Oscillators according to the specified parameters
  * in the RCC_OscInitTypeDef structure.
  */
  RCC_OscInitStruct.OscillatorType = RCC_OSCILLATORTYPE_HSI;
  RCC_OscInitStruct.HSIState = RCC_HSI_ON;
  RCC_OscInitStruct.HSICalibrationValue = RCC_HSICALIBRATION_DEFAULT;
  RCC_OscInitStruct.PLL.PLLState = RCC_PLL_ON;
  RCC_OscInitStruct.PLL.PLLSource = RCC_PLLSOURCE_HSI;
  RCC_OscInitStruct.PLL.PLLM = RCC_PLLM_DIV4;
  RCC_OscInitStruct.PLL.PLLN = 85;
  RCC_OscInitStruct.PLL.PLLP = RCC_PLLP_DIV2;
  RCC_OscInitStruct.PLL.PLLQ = RCC_PLLQ_DIV2;
  RCC_OscInitStruct.PLL.PLLR = RCC_PLLR_DIV2;
  if (HAL_RCC_OscConfig(&RCC_OscInitStruct) != HAL_OK)
  {
    Error_Handler();
  }

  /** Initializes the CPU, AHB and APB buses clocks
  */
  RCC_ClkInitStruct.ClockType = RCC_CLOCKTYPE_HCLK|RCC_CLOCKTYPE_SYSCLK
                              |RCC_CLOCKTYPE_PCLK1|RCC_CLOCKTYPE_PCLK2;
  RCC_ClkInitStruct.SYSCLKSource = RCC_SYSCLKSOURCE_PLLCLK;
  RCC_ClkInitStruct.AHBCLKDivider = RCC_SYSCLK_DIV1;
  RCC_ClkInitStruct.APB1CLKDivider = RCC_HCLK_DIV1;
  RCC_ClkInitStruct.APB2CLKDivider = RCC_HCLK_DIV1;

  if (HAL_RCC_ClockConfig(&RCC_ClkInitStruct, FLASH_LATENCY_4) != HAL_OK)
  {
    Error_Handler();
  }
}

/**
  * @brief TIM2 CH1: 1 kHz PWM on PA5 (170 MHz timer clock).
  */
static void MX_TIM2_Init(void)
{
  TIM_OC_InitTypeDef sConfigOC = {0};

  htim2.Instance = TIM2;
  htim2.Init.Prescaler = 169;
  htim2.Init.CounterMode = TIM_COUNTERMODE_UP;
  htim2.Init.Period = 999;
  htim2.Init.ClockDivision = TIM_CLOCKDIVISION_DIV1;
  htim2.Init.AutoReloadPreload = TIM_AUTORELOAD_PRELOAD_ENABLE;
  if (HAL_TIM_PWM_Init(&htim2) != HAL_OK)
  {
    Error_Handler();
  }

  /* PWM1, active high: CNT < CCR1 means LED on. */
  sConfigOC.OCMode = TIM_OCMODE_PWM1;
  sConfigOC.Pulse = 0;
  sConfigOC.OCPolarity = TIM_OCPOLARITY_HIGH;
  sConfigOC.OCFastMode = TIM_OCFAST_DISABLE;
  if (HAL_TIM_PWM_ConfigChannel(&htim2, &sConfigOC, TIM_CHANNEL_1) != HAL_OK)
  {
    Error_Handler();
  }
  HAL_TIM_MspPostInit(&htim2);
}

/**
  * @brief TIM6: update interrupt every 10 ms (170 MHz timer clock).
  */
static void MX_TIM6_Init(void)
{
  htim6.Instance = TIM6;
  /* 170 MHz / 17000 / 100 = 100 Hz, i.e. one update every 10 ms. */
  htim6.Init.Prescaler = 16999;
  htim6.Init.CounterMode = TIM_COUNTERMODE_UP;
  htim6.Init.Period = 99;
  htim6.Init.AutoReloadPreload = TIM_AUTORELOAD_PRELOAD_DISABLE;
  if (HAL_TIM_Base_Init(&htim6) != HAL_OK)
  {
    Error_Handler();
  }
}

static void MX_GPIO_Init(void)
{

  /* GPIO Ports Clock Enable */
  __HAL_RCC_GPIOC_CLK_ENABLE();
  __HAL_RCC_GPIOF_CLK_ENABLE();
  __HAL_RCC_GPIOA_CLK_ENABLE();
  __HAL_RCC_GPIOB_CLK_ENABLE();

}

/* USER CODE BEGIN 4 */
/* Called only from main: never wait for UART transmission inside an IRQ. */
static void UART_ProcessCommand(void)
{
  char reply[64];
  uint8_t command;
  bool paused;
  uint32_t compare;
  uint32_t irqMask = __get_PRIMASK();

  /* Take one command and a consistent LED snapshot without an IRQ intervening. */
  __disable_irq();
  if (uartCommandTail == uartCommandHead)
  {
    __set_PRIMASK(irqMask);
    return;
  }
  command = uartCommands[uartCommandTail];
  uartCommandTail = (uartCommandTail + 1U) % UART_COMMAND_QUEUE_SIZE;
  if (command == 'p')
  {
    isPaused = true;
  }
  else if (command == 'r')
  {
    isPaused = false;
  }
  paused = isPaused;
  compare = __HAL_TIM_GET_COMPARE(&htim2, TIM_CHANNEL_1);
  __set_PRIMASK(irqMask);

  int length;
  if (command == 's')
  {
    length = snprintf(reply, sizeof(reply), "paused=%u, CCR1=%lu\r\n",
                      paused ? 1U : 0U, (unsigned long)compare);
  }
  else
  {
    length = snprintf(reply, sizeof(reply), "%s\r\n",
                      paused ? "Paused" : "Running");
  }

  if ((length < 0) || ((size_t)length >= sizeof(reply)))
  {
    Error_Handler();
    return;
  }
  if (HAL_UART_Transmit(&hcom_uart[COM1], (const uint8_t *)reply,
                        (uint16_t)length, 100U) != HAL_OK)
  {
    Error_Handler();
  }
}

void HAL_TIM_PeriodElapsedCallback(TIM_HandleTypeDef *htim)
{
  /* These variables belong only to this ISR and persist between interrupts. */
  static int32_t pulse = 0;
  static int32_t step = 10;

  if (htim->Instance == TIM6)
  {
    if (isPaused) return;
    /* 100 steps up + 100 steps down: a complete breath takes 2 seconds. */
    pulse += step;
    if (pulse >= 1000)
    {
      pulse = 1000;
      step = -10;
    }
    else if (pulse <= 0)
    {
      pulse = 0;
      step = 10;
    }
    __HAL_TIM_SET_COMPARE(&htim2, TIM_CHANNEL_1, (uint32_t)pulse);
  }
}

void BSP_PB_Callback(Button_TypeDef Button)
{
  if (Button == BUTTON_USER)
  {
    /* TODO: Add your button handling logic here (interrupt context). */
    isPaused = !isPaused;
  }
}

void HAL_UART_RxCpltCallback(UART_HandleTypeDef *huart)
{
  if (huart == &hcom_uart[COM1])
  {
    uint8_t command = uartRxByte;

    /* A one-byte reception completes once; arm the next one explicitly. */
    if (HAL_UART_Receive_IT(huart, &uartRxByte, 1U) != HAL_OK)
    {
      Error_Handler();
    }

    if ((command == 'p') || (command == 'r') || (command == 's'))
    {
      uint32_t next = (uartCommandHead + 1U) % UART_COMMAND_QUEUE_SIZE;
      if (next != uartCommandTail)
      {
        uartCommands[uartCommandHead] = command;
        uartCommandHead = next;
      }
      /* If full, discard the new command; normal interactive input fits. */
    }
    /* Ignore other characters, including terminal line endings. */
  }
}

void HAL_UART_ErrorCallback(UART_HandleTypeDef *huart)
{
  /* Overrun can end interrupt reception; rearm it after HAL clears the error. */
  if ((huart == &hcom_uart[COM1]) &&
      (huart->RxState == HAL_UART_STATE_READY))
  {
    if (HAL_UART_Receive_IT(huart, &uartRxByte, 1U) != HAL_OK)
    {
      Error_Handler();
    }
  }
}

/* USER CODE END 4 */

void Error_Handler(void)
{
  __disable_irq();
  while (1)
  {
  }
}
